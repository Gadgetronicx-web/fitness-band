

// Include header files 
#define BLYNK_PRINT Serial
#include<ESP8266WiFi.h>
#include <BlynkSimpleEsp8266.h>

// Auth token generated by Blynk
char auth[] = "gTJf3EcGRGacgcW24I-OWcmj70OlwjZ2";    //Replace with your Auth token

// Your WiFi credentials.
// Set password to "" for open networks.
char ssid[] = "Your SSID";        //Replace with your SSID
char pass[] = "Your Password";    //Replace with your password

// Extenal LED 
int led_pin = D6;

// Variables required for calibrations
const int postingInterval = 10 * 1000; 
int rate[10];                    
unsigned long sampleCounter = 0; 
unsigned long lastBeatTime = 0;  
unsigned long lastTime = 0, N;
int BPM = 0;
int IBI = 0;
int P = 512;
int T = 512;
int thresh = 512;  
int amp = 100;                   
int Signal;
boolean Pulse = false;
boolean firstBeat = true;          
boolean secondBeat = true;
boolean QS = false;    

//Variables required to calculations 
boolean time_noted=false;
unsigned long starting_time=0;        //starting time of the device in millis second
boolean mail_sent=false;    
unsigned long average_bpm=0;          // stores average bpm
unsigned long bpm_counted=0;          // stores number of times bpm is calculated
boolean male=true;
int weight=0;
int age=0;
int start_button=0;
int does_mail_send =0;
int heart_rate=0;
float calorie_burn;
float time_duration=0;
float total_calorie_burn=0;

// Setup block
void setup() {
  // put your setup code here, to run once:
   Serial.begin(115200);

   //Pinmodes 
   pinMode(A0,INPUT);
   pinMode(led_pin,OUTPUT);

   //Blynk setup
   Blynk.begin(auth, ssid, pass); 

}

void loop() {
  // put your main code here, to run repeatedly:
  Blynk.run();    // Blynk will run continuously

  // here if block will execute when start button in the blynk is ON
  if(start_button==1 && time_noted==true){
    //Serial.println("BPM is Calculating");
    calculate_bpm();        
    if(millis()-starting_time>=10000){
        calculate_calories_10sec();  // calculate calories burnt for every 10 minutes
    }
  } 
  // else if block will get executed when the starts button gets off
  else if(mail_sent==true){
    calculate_calories_10sec();
    send_email();
    mail_sent=false;
    reset_bpm();    // reset the variables when device gets OFF
  }

}

// This function calculates calories burnt in every 10 seconds and update it into blynk
void calculate_calories_10sec(){
  starting_time=millis();
  heart_rate=average_bpm/bpm_counted;
  if(male==true){
    Serial.println("Male");
    calorie_burn=(float)( ((-55.0969+(0.6309*heart_rate)+(0.1988*weight)+(0.2017*age))/4.184)*60*0.00277778);
  }
  else{
    Serial.println("Female");
    calorie_burn=(float)( ((-20.4022+(0.4472*heart_rate)-(0.1263*weight)+(0.074*age))/4.184)*60*0.00277778);
  }
  total_calorie_burn+=calorie_burn;
  Serial.println(weight);
  Serial.println(age);
  Serial.println(average_bpm);
  Serial.println(bpm_counted);
  Serial.println(calorie_burn);
  Serial.println(time_duration);
  Serial.println(starting_time);
  Blynk.virtualWrite(V7,total_calorie_burn);
}

// this function is used to send email to the user about his status when the device gets off
void send_email()
{ 
  if(does_mail_send == 0){
    String msg="Hi Nihar Gupta. Your average heart beat is:"+(String)heart_rate+". Your "+(String)calorie_burn+"calories are burned during the time of"+(String)time_duration+"Hrs";
    Blynk.email("youremail@example.com", "Heart Beat Notification", msg);     //Replace with your email
    does_mail_send = 1;
  }
}

// Reset the variables when the device is get off
void reset_bpm(){
  average_bpm=0;
  bpm_counted=0;
  total_calorie_burn=0;
}

// This function will take care to initilize BPM
void calculate_bpm(){
  if (QS == true) {
   Serial.println("BPM: "+ String(BPM));
   Blynk.virtualWrite(V1,BPM);
   average_bpm+=BPM;
   bpm_counted++;
   QS = false;
   } else if (millis() >= (lastTime + 2)) {
     readPulse();
     lastTime = millis();
   }
        
}

// This function will read the analog data and calibrate the data into BPM
void readPulse() {
  Signal = analogRead(A0);       
  analogWrite(led_pin,Signal);    
  sampleCounter += 2;                           
  int N = sampleCounter - lastBeatTime;   
  detectSetHighLow();
  if (N > 250) {  
    if ( (Signal > thresh) && (Pulse == false) && (N > (IBI / 5) * 3) )
      pulseDetected();
  }
  if (Signal < thresh && Pulse == true) {  
    Pulse = false;
    amp = P - T;
    thresh = amp / 2 + T;  
    P = thresh;
    T = thresh;
  }
  if (N > 2500) {
    thresh = 512;
    P = 512;
    T = 512;
    lastBeatTime = sampleCounter;
    firstBeat = true;            
    secondBeat = true;           
  }
}
void detectSetHighLow() {
  if (Signal < thresh && N > (IBI / 5) * 3) {
    if (Signal < T) {                       
      T = Signal;                         
    }
  }
  if (Signal > thresh && Signal > P) {    
    P = Signal;                           
  }                                       
}

// This calibration is when a pulse is detected
void pulseDetected() {
  Pulse = true;                           
  IBI = sampleCounter - lastBeatTime;     
  lastBeatTime = sampleCounter;           

  if (firstBeat) {                       
    firstBeat = false;                 
    return;                            
  }
  if (secondBeat) {                    
    secondBeat = false;                
    for (int i = 0; i <= 9; i++) {   
      rate[i] = IBI;
    }
  }

  word runningTotal = 0;                   

  for (int i = 0; i <= 8; i++) {          
    rate[i] = rate[i + 1];            
    runningTotal += rate[i];          
  }

  rate[9] = IBI;                      
  runningTotal += rate[9];            
  runningTotal /= 10;                 
  BPM = 60000 / runningTotal;         
  QS = true;
}                           

// To know Start button in blynk is ON/OFF
BLYNK_WRITE(V9) 
{
  start_button = param.asInt();
  if(start_button==1 && time_noted==false){
    starting_time=millis();
    mail_sent=false;
    does_mail_send=0;
    time_noted = true;
  }
  else if(start_button==0 && time_noted==true){
    mail_sent = true;
    time_noted=false;
  }
}

// Update gender when it is changed
BLYNK_WRITE(V2){
  switch(param.asInt()){
    case 1:{ male=true;
             break;
           }
    case 2:{male=false;
            break;      
           }
  }
}

// update weight when it is changed in Blynk
BLYNK_WRITE(V3){
  weight = param.asInt();
}

// update age when it is changed in Blynk
BLYNK_WRITE(V4){
  age=param.asInt();
}
